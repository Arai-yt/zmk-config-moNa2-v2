## config/west.yml
```yaml
manifest:
  remotes:
    - name: zmkfirmware
      url-base: https://github.com/zmkfirmware
    - name: sayu-hub
      url-base: https://github.com/sayu-hub
    - name: badjeff    # <-- PMW3610
      url-base: https://github.com/badjeff
    # - name: sekigon-gonnoc  # <-- PAW3222
    #   url-base: https://github.com/sekigon-gonnoc
    - name: caksoylar  # <-- RGB LED
      url-base: https://github.com/caksoylar  
    - name: zettaface  # <-- Input Processor Keybind
      url-base: https://github.com/zettaface
    - name: kot149
      url-base: https://github.com/kot149
  projects:
    - name: zmk
      remote: zmkfirmware
      revision: v0.3.0
      import: app/west.yml
    - name: zmk-pmw3610-driver
      remote: badjeff
      revision: main
    # - name: zmk-driver-paw3222
    #   remote: sekigon-gonnoc
    #   revision: main
    - name: zmk-rgbled-widget
      remote: caksoylar
      revision: main
    - name: zmk-input-processor-keybind
      remote: zettaface
      revision: main
    - name: zmk-mouse-gesture
      remote: kot149
      revision: v1
  self:
    path: config
```

## modules/mona_gestures/Kconfig
```kconfig
menu "moNa extras"
config MONA_DIR_GESTURES
    bool "Directional gestures input processor"
    default y
    select ZMK_INPUT_PROCESSORS
endmenu
```

## modules/mona_gestures/dts/bindings/input/mona,dir-gestures.yaml
```yaml
# SPDX-License-Identifier: MIT
compatible: "mona,dir-gestures"
description: Directional gesture input-processor (trackball flick -> key/macro)

include: base.yaml

properties:
  threshold:
    type: int
    required: true
    description: Sum of delta required to trigger (counts)
  timeout-ms:
    type: int
    required: true
    description: Time window to accumulate deltas (ms)
  bindings-up:
    type: phandle-array
    required: true
    description: ZMK behavior binding invoked on UP flick
  bindings-down:
    type: phandle-array
    required: true
    description: ZMK behavior binding invoked on DOWN flick
  bindings-left:
    type: phandle-array
    required: true
    description: ZMK behavior binding invoked on LEFT flick
  bindings-right:
    type: phandle-array
    required: true
    description: ZMK behavior binding invoked on RIGHT flick
```
